/dts-v1/;

/include/ "msm8953.dtsi"
/include/ "sdm450_huawei_common.dtsi"

/ {
	model = "Huawei Technologies, Inc. LND-AL30";
	compatible = "qcom,sdm450-qrd", "qcom,sdm450", "qcom,qrd", "lk2nd,device";
	qcom,board-id= <201f 0>;
	qcom,pmic-id = <0x10016 0x20011 0x00 0x00>;
	huawei,modem_id = <0xf7fc011e 0x00>;
};
